/* Copyright (c) 2015, The Linux Foundation. All rights reserved.
 *
 * This program is free software; you can redistribute it and/or modify
 * it under the terms of the GNU General Public License version 2 and
 * only version 2 as published by the Free Software Foundation.
 *
 * This program is distributed in the hope that it will be useful,
 * but WITHOUT ANY WARRANTY; without even the implied warranty of
 * MERCHANTABILITY or FITNESS FOR A PARTICULAR PURPOSE.  See the
 * GNU General Public License for more details.
 */

/*---------------------------------------------------------------------------
 * This file is autogenerated file using gcdb parser. Please do not edit it.
 * Update input XML file to add a new entry or update variable in this file
 * VERSION = "1.0"
 *---------------------------------------------------------------------------*/
&mdss_mdp {
	dsi_r69338_helitech_1080p_video: qcom,mdss_dsi_r69338_helitech_1080p_video {
		qcom,mdss-dsi-panel-name = "r69338 helitech 1080p video mode dsi panel";
		zte,lcd-proc-panel-name ="zteHelitech(r69338)_1080*1920-5.5Inch";
		qcom,cont-splash-enabled;
		qcom,mdss-dsi-panel-controller = <&mdss_dsi0>;
		qcom,mdss-dsi-panel-type = "dsi_video_mode";
		qcom,mdss-dsi-panel-destination = "display_1";
		qcom,mdss-dsi-panel-framerate = <57>;
		qcom,mdss-dsi-virtual-channel-id = <0>;
		qcom,mdss-dsi-stream = <0>;
		qcom,mdss-dsi-panel-width = <1080>;
		qcom,mdss-dsi-panel-height = <1920>;
		qcom,mdss-dsi-h-front-porch = <156>;
		qcom,mdss-dsi-h-back-porch = <47>;
		qcom,mdss-dsi-h-pulse-width = <5>;
		qcom,mdss-dsi-h-sync-skew = <0>;
		qcom,mdss-dsi-v-front-porch = <18>;
		qcom,mdss-dsi-v-back-porch = <3>;
		qcom,mdss-dsi-v-pulse-width = <1>;
		qcom,mdss-dsi-h-left-border = <0>;
		qcom,mdss-dsi-h-right-border = <0>;
		qcom,mdss-dsi-v-top-border = <0>;
		qcom,mdss-dsi-v-bottom-border = <0>;
		qcom,mdss-dsi-bpp = <24>;
		qcom,mdss-dsi-underflow-color = <0xff>;
		qcom,mdss-dsi-border-color = <0>;
		qcom,mdss-dsi-on-command = [
29 01 00 00 00 00 02 b0 04
29 01 00 00 00 00 0B e1 01 00 00 00 93 38 10 55 0b 00
29 01 00 00 00 00 08 B3 14 1a 00 00 00 00 00 
29 01 00 00 00 00 02 B4 0C
29 01 00 00 00 00 03 B6 3A D3 
29 01 00 00 00 00 2D C1 84 60 00 52 CA 12 04 19 40 19 D9 D8 82 CF B9 07 17 6B F2 80 41 44 90 52 4A 09 00 00 00 00 A0 40 42 20 12 00 22 00 15 00 01 00 00 00
29 01 00 00 00 00 0A C2 31 F7 80 00 04 00 08 00 00
29 01 00 00 00 00 10 C4 70 00 00 00 00 00 00 00 00 00 03 15 15 15 01
29 01 00 00 00 00 15 C6 49 11 11 17 2D 01 01 01 01 01 01 3E 0A 01 01 01 01 02 12 03
29 01 00 00 00 00 0D CB F8 F7 FF 7E 30 00 00 00 00 00 3C CF

29 01 00 00 00 00 02 CC 0D
29 01 00 00 00 00 06 D0 10 91 BB 10 90
29 01 00 00 00 00 06 D1 25 00 19 61 06
29 01 00 00 00 00 1C D3 0B 37 9F BF B7 33 33 17 00 01 00 A0 D8 A0 0D 53 53 33 3B F7 72 07 3D BF 99 21 FA
29 01 00 00 00 00 0C D5 06 00 00 01 28 01 28 00 00 00 00

29 01 00 00 00 00 02 D6 01 
29 01 00 00 00 00 0D D9 04 32 AA AA AA E4 02 00 0F 00 00 00
29 01 00 00 00 00 31 EC 2D 10 2C 55 01 00 00 00 68 13 13 00 00 9A 00 00 07 09 31 11 0F 00 00 00 00 50 03 00 00 00 00 05 FC 00 00 00 03 40 02 12 02 02 01 00 00 00 00 00
29 01 00 00 00 00 20 ED 41 13 13 03 24 11 02 90 00 03 00 00 00 03 21 24 00 A6 80 A4 05 32 30 00 00 1D 00 00 00 00 00
29 01 00 00 00 00 20 EE 20 13 13 03 00 10 02 00 00 03 00 00 00 03 00 00 01 4E 01 4C 0A 73 20 00 00 3A 00 00 00 00 00
29 01 00 00 00 00 3f EF 41 13 13 03 24 11 02 90 00 03 00 00 00 03 21 24 00 A6 80 A4 05 32 30 00 00 1D 00 00 00 00 00 41 13 13 03 24 11 02 90 00 F3 00 00 49 00 03 21 24 00 A6 80 A4 05 32 30 00 1D 00 00 00 00 00
29 01 00 00 00 00 1F C7 00 13 1D 2A 3B 49 53 61 45 4C 57 64 6E 75 7F 00 13 1D 2A 3B 49 53 61 45 4C 57 64 6E 75 7F 
29 01 00 00 00 00 14 C8 01 00 FF 01 FF FC 00 00 01 F1 F4 F1 0F 00 FA F1 EB FC 11 

29 01 00 00 00 00 02 B0 03
29 01 00 00 00 00 02 B0 02
			15 01 00 00 05 00 02 51 00
			15 01 00 00 05 00 02 53 24
			15 01 00 00 05 00 02 55 01
05 01 00 00 A0 00 02 29 00
05 01 00 00 C8 00 02 11 00
];
		qcom,mdss-dsi-off-command = [05 01 00 00 14 00 02 28 00
			05 01 00 00 78 00 02 10 00];
		qcom,mdss-dsi-on-command-state = "dsi_lp_mode";
		qcom,mdss-dsi-off-command-state = "dsi_hs_mode";
		qcom,mdss-dsi-lp11-init;
		qcom,mdss-dsi-h-sync-pulse = <0>;
		qcom,mdss-dsi-traffic-mode = "burst_mode";
		qcom,mdss-dsi-bllp-eof-power-mode;
		qcom,mdss-dsi-bllp-power-mode;
		qcom,mdss-dsi-lane-0-state;
		qcom,mdss-dsi-lane-1-state;
		qcom,mdss-dsi-lane-2-state;
		qcom,mdss-dsi-lane-3-state;
		qcom,mdss-dsi-panel-timings = [E2 36 24 00 66 68 28 38 2A 03 04 00];
		qcom,mdss-dsi-t-clk-post = <0x02>;
		qcom,mdss-dsi-t-clk-pre = <0x2A>;
		qcom,mdss-dsi-bl-min-level = <1>;
		qcom,mdss-dsi-bl-max-level = <235>;
		qcom,mdss-dsi-dma-trigger = "trigger_sw";
		qcom,mdss-dsi-mdp-trigger = "none";
		qcom,mdss-dsi-bl-pmic-control-type = "bl_ctrl_dcs_wled";
		qcom,mdss-dsi-reset-sequence = <1 20>, <0 20>, <1 120>;
		qcom,mdss-pan-physical-width-dimension = <68>;
		qcom,mdss-pan-physical-height-dimension = <121>;
		//zte,panel-reset-early-enabled;
	};
};
