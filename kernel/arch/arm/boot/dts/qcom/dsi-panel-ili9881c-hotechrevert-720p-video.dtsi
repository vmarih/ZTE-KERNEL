/* Copyright (c) 2015-2016, The Linux Foundation. All rights reserved.
 *
 * This program is free software; you can redistribute it and/or modify
 * it under the terms of the GNU General Public License version 2 and
 * only version 2 as published by the Free Software Foundation.
 *
 * This program is distributed in the hope that it will be useful,
 * but WITHOUT ANY WARRANTY; without even the implied warranty of
 * MERCHANTABILITY or FITNESS FOR A PARTICULAR PURPOSE.  See the
 * GNU General Public License for more details.
 */

&mdss_mdp {
	dsi_ili9881c_hotechrevert_720p_video: qcom,mdss_dsi_ili9881c_hotechrevert_720p_video {
		qcom,mdss-dsi-panel-name = "ili9881c hotechrevert 720p video mode dsi pane";
		zte,lcd-proc-panel-name ="ztehotechrevert(ili9881c)_720*1280-5.2Inch";
		qcom,cont-splash-enabled;
		qcom,mdss-dsi-panel-controller = <&mdss_dsi0>;
		qcom,mdss-dsi-panel-type = "dsi_video_mode";
		qcom,mdss-dsi-panel-destination = "display_1";
		qcom,mdss-dsi-panel-framerate = <60>;
		qcom,mdss-dsi-virtual-channel-id = <0>;
		qcom,mdss-dsi-stream = <0>;
		qcom,mdss-dsi-panel-width = <720>;
		qcom,mdss-dsi-panel-height = <1280>;
		qcom,mdss-dsi-h-front-porch = <145>;
		qcom,mdss-dsi-h-back-porch = <120>;
		qcom,mdss-dsi-h-pulse-width = <14>;
		qcom,mdss-dsi-h-sync-skew = <0>;
		qcom,mdss-dsi-v-front-porch = <40>;
		qcom,mdss-dsi-v-back-porch = <80>;
		qcom,mdss-dsi-v-pulse-width = <30>;
		qcom,mdss-dsi-h-left-border = <0>;
		qcom,mdss-dsi-h-right-border = <0>;
		qcom,mdss-dsi-v-top-border = <0>;
		qcom,mdss-dsi-v-bottom-border = <0>;
		qcom,mdss-dsi-bpp = <24>;
		qcom,mdss-dsi-underflow-color = <0xff>;
		qcom,mdss-dsi-border-color = <0>;
		qcom,mdss-dsi-h-sync-pulse = <0>;
		qcom,mdss-dsi-traffic-mode = "burst_mode";
		qcom,mdss-dsi-bllp-eof-power-mode;
		qcom,mdss-dsi-bllp-power-mode;
		qcom,mdss-dsi-lane-0-state;
		qcom,mdss-dsi-lane-1-state;
		qcom,mdss-dsi-lane-2-state;
		qcom,mdss-dsi-lane-3-state;
                qcom,mdss-dsi-panel-timings = [94 20 14 00 46 4A 1A 24 18 03 04 00];
		qcom,mdss-dsi-t-clk-post = <0x04>;
		qcom,mdss-dsi-t-clk-pre = <0x1B>;
		qcom,mdss-dsi-bl-min-level = <1>;
		qcom,mdss-dsi-bl-max-level = <4095>;
		qcom,mdss-dsi-dma-trigger = "trigger_sw";
		qcom,mdss-dsi-mdp-trigger = "none";
		qcom,mdss-dsi-on-command = [
			29 01 00 00 00 00 04 FF 98 81 03
			29 01 00 00 00 00 02 01 00
			29 01 00 00 00 00 02 02 00
                        29 01 00 00 00 00 02 03 53
                        29 01 00 00 00 00 02 04 13
                        29 01 00 00 00 00 02 05 00
                        29 01 00 00 00 00 02 06 04
                        29 01 00 00 00 00 02 07 02
                        29 01 00 00 00 00 02 08 00
                        29 01 00 00 00 00 02 09 01
                        29 01 00 00 00 00 02 0a 00
                        29 01 00 00 00 00 02 0b 00
                        29 01 00 00 00 00 02 0c 01
                        29 01 00 00 00 00 02 0d 00
                        29 01 00 00 00 00 02 0e 00
                        29 01 00 00 00 00 02 0f 1b
                        29 01 00 00 00 00 02 10 1b
                        29 01 00 00 00 00 02 11 00
                        29 01 00 00 00 00 02 12 00
                        29 01 00 00 00 00 02 13 00
                        29 01 00 00 00 00 02 14 00
                        29 01 00 00 00 00 02 15 00
                        29 01 00 00 00 00 02 16 00
                        29 01 00 00 00 00 02 17 00
                        29 01 00 00 00 00 02 18 00
                        29 01 00 00 00 00 02 19 00
                        29 01 00 00 00 00 02 1a 00
                        29 01 00 00 00 00 02 1b 00
                        29 01 00 00 00 00 02 1c 00
                        29 01 00 00 00 00 02 1d 00
                        29 01 00 00 00 00 02 1e 44
                        29 01 00 00 00 00 02 1f 80
                        29 01 00 00 00 00 02 20 02
			29 01 00 00 00 00 02 21 01
			29 01 00 00 00 00 02 22 00
			29 01 00 00 00 00 02 23 00
			29 01 00 00 00 00 02 24 00
			29 01 00 00 00 00 02 25 00
			29 01 00 00 00 00 02 26 00
			29 01 00 00 00 00 02 27 00
			29 01 00 00 00 00 02 28 33
			29 01 00 00 00 00 02 29 03
			29 01 00 00 00 00 02 2a 00
			29 01 00 00 00 00 02 2b 00
			29 01 00 00 00 00 02 2c 00
			29 01 00 00 00 00 02 2d 00
			29 01 00 00 00 00 02 2e 00
			29 01 00 00 00 00 02 2f 00
			29 01 00 00 00 00 02 30 00
			29 01 00 00 00 00 02 31 00
			29 01 00 00 00 00 02 32 00
			29 01 00 00 00 00 02 33 00
			29 01 00 00 00 00 02 34 04
			29 01 00 00 00 00 02 35 00
			29 01 00 00 00 00 02 36 00
			29 01 00 00 00 00 02 37 00
			29 01 00 00 00 00 02 38 3C
			29 01 00 00 00 00 02 39 00
			29 01 00 00 00 00 02 3a 40
			29 01 00 00 00 00 02 3b 40
			29 01 00 00 00 00 02 3c 00
			29 01 00 00 00 00 02 3d 00
			29 01 00 00 00 00 02 3e 00
			29 01 00 00 00 00 02 3f 00
			29 01 00 00 00 00 02 40 00
			29 01 00 00 00 00 02 41 00
			29 01 00 00 00 00 02 42 00
			29 01 00 00 00 00 02 43 00
			29 01 00 00 00 00 02 44 00
			29 01 00 00 00 00 02 50 01
			29 01 00 00 00 00 02 51 23
			29 01 00 00 00 00 02 52 45
			    29 01 00 00 00 00 02 53 67
			29 01 00 00 00 00 02 54 89
			29 01 00 00 00 00 02 55 ab
			29 01 00 00 00 00 02 56 01
			29 01 00 00 00 00 02 57 23
			29 01 00 00 00 00 02 58 45
			29 01 00 00 00 00 02 59 67
			29 01 00 00 00 00 02 5a 89
			29 01 00 00 00 00 02 5b ab
			29 01 00 00 00 00 02 5c cd
			29 01 00 00 00 00 02 5d ef
			29 01 00 00 00 00 02 5e 11
			29 01 00 00 00 00 02 5f 01
			29 01 00 00 00 00 02 60 00
			29 01 00 00 00 00 02 61 15
			29 01 00 00 00 00 02 62 14
			29 01 00 00 00 00 02 63 0C
			29 01 00 00 00 00 02 64 0D
			29 01 00 00 00 00 02 65 0E
			29 01 00 00 00 00 02 66 0F
			29 01 00 00 00 00 02 67 06
			29 01 00 00 00 00 02 68 02
			29 01 00 00 00 00 02 69 02
			29 01 00 00 00 00 02 6a 02
			29 01 00 00 00 00 02 6b 02
			29 01 00 00 00 00 02 6c 02
			29 01 00 00 00 00 02 6d 02
			29 01 00 00 00 00 02 6e 08
			29 01 00 00 00 00 02 6f 02
			29 01 00 00 00 00 02 70 02
			29 01 00 00 00 00 02 71 02
			29 01 00 00 00 00 02 72 02
			29 01 00 00 00 00 02 73 02
			29 01 00 00 00 00 02 74 02
			29 01 00 00 00 00 02 75 01
			29 01 00 00 00 00 02 76 00
			29 01 00 00 00 00 02 77 15
			29 01 00 00 00 00 02 78 14
                        29 01 00 00 00 00 02 79 0C
                        29 01 00 00 00 00 02 7a 0D
                        29 01 00 00 00 00 02 7b 0E
                        29 01 00 00 00 00 02 7c 0F
                        29 01 00 00 00 00 02 7d 08
                        29 01 00 00 00 00 02 7e 02
                        29 01 00 00 00 00 02 7f 02
                        29 01 00 00 00 00 02 80 02
                        29 01 00 00 00 00 02 81 02
                        29 01 00 00 00 00 02 82 02
                        29 01 00 00 00 00 02 83 02
			29 01 00 00 00 00 02 84 06
			29 01 00 00 00 00 02 85 02
			29 01 00 00 00 00 02 86 02
			29 01 00 00 00 00 02 87 02
			29 01 00 00 00 00 02 88 02
			29 01 00 00 00 00 02 89 02
			29 01 00 00 00 00 02 8A 02
			29 01 00 00 00 00 04 FF 98 81 04
				29 01 00 00 00 00 02 35 1f
			29 01 00 00 00 00 02 6E 2A
			29 01 00 00 00 00 02 6F 33
			    29 01 00 00 00 00 02 8D 16
			29 01 00 00 00 00 02 87 BA
			29 01 00 00 00 00 02 26 76
			29 01 00 00 00 00 02 B2 D1
                        29 01 00 00 00 00 02 B5 06
                29 01 00 00 00 00 02 3A 24
                        29 01 00 00 00 00 04 FF 98 81 01
                        29 01 00 00 00 00 02 22 09
                        29 01 00 00 00 00 02 31 00
                29 01 00 00 00 00 02 50 A5
                29 01 00 00 00 00 02 51 A0
                29 01 00 00 00 00 02 60 14
				29 01 00 00 00 00 02 63 00
                29 01 00 00 00 00 02 A0 07
                29 01 00 00 00 00 02 A1 18
			    29 01 00 00 00 00 02 A2 24
			    29 01 00 00 00 00 02 A3 14
			    29 01 00 00 00 00 02 A4 17
			    29 01 00 00 00 00 02 A5 29
			    29 01 00 00 00 00 02 A6 1d
			    29 01 00 00 00 00 02 A7 1e
			    29 01 00 00 00 00 02 A8 7c
			29 01 00 00 00 00 02 A9 1B
			29 01 00 00 00 00 02 AA 27
			    29 01 00 00 00 00 02 AB 6d
			    29 01 00 00 00 00 02 AC 18
			    29 01 00 00 00 00 02 AD 16
			    29 01 00 00 00 00 02 AE 4a
			    29 01 00 00 00 00 02 AF 1e
			    29 01 00 00 00 00 02 B0 25
			    29 01 00 00 00 00 02 B1 56
			    29 01 00 00 00 00 02 B2 69
			    29 01 00 00 00 00 02 B3 3f
			    29 01 00 00 00 00 02 C0 03
			    29 01 00 00 00 00 02 C1 12
			    29 01 00 00 00 00 02 C2 20
			    29 01 00 00 00 00 02 C3 14
			    29 01 00 00 00 00 02 C4 17
			    29 01 00 00 00 00 02 C5 29
			    29 01 00 00 00 00 02 C6 1d
			    29 01 00 00 00 00 02 C7 1e
			    29 01 00 00 00 00 02 C8 7c
		    	29 01 00 00 00 00 02 C9 1B
			    29 01 00 00 00 00 02 CA 27
			    29 01 00 00 00 00 02 CB 6d
			    29 01 00 00 00 00 02 CC 18
			    29 01 00 00 00 00 02 CD 16
			    29 01 00 00 00 00 02 CE 4a
			    29 01 00 00 00 00 02 CF 1e
			    29 01 00 00 00 00 02 D0 25
			    29 01 00 00 00 00 02 D1 56
                29 01 00 00 00 00 02 D2 69
                29 01 00 00 00 00 02 D3 3f
						39 00 00 00 00 00 04 FF 98 81 02
						39 00 00 00 00 00 02 06 40
						39 00 00 00 00 00 02 07 04
                        29 01 00 00 00 00 04 FF 98 81 00
                        29 01 00 00 00 00 02 35 00
						29 01 00 00 00 00 03 68 03 01
                        39 00 00 00 00 00 03 51 00 30
						39 00 00 00 00 00 02 53 24
						39 00 00 00 00 00 02 55 01 //00êP cabc //01é_cabc
						29 01 00 00 78 00 02 11 00
                        29 01 00 00 14 00 02 29 00
		];
		qcom,mdss-dsi-off-command = [
						29 01 00 00 00 00 04 FF 98 81 00
                        05 01 00 00 14 00 02 28 00
                        05 01 00 00 78 00 02 10 00
		];
		qcom,mdss-dsi-on-command-state = "dsi_lp_mode";
                qcom,mdss-dsi-off-command-state = "dsi_lp_mode";
		qcom,mdss-dsi-lp11-init;
		qcom,mdss-dsi-bl-pmic-control-type = "bl_ctrl_dcs";
		qcom,mdss-dsi-reset-sequence = <1 10>, <0 10>, <1 120>;
		qcom,mdss-dsi-post-init-delay = <1>;
		qcom,mdss-dsi-panel-status-check-mode = "reg_read";
		qcom,mdss-dsi-panel-status-command = [06 01 00 01 05 00 02 0A 00];
		qcom,mdss-dsi-panel-status-command-state = "dsi_lp_mode";
		qcom,mdss-dsi-panel-status-read-length = <1>;
		qcom,mdss-dsi-panel-status-value = <0x9C>;
		qcom,mdss-dsi-tx-eot-append;
		qcom,esd-check-enabled;
	};
};
