/* Copyright (c) 2015, The Linux Foundation. All rights reserved.
 *
 * This program is free software; you can redistribute it and/or modify
 * it under the terms of the GNU General Public License version 2 and
 * only version 2 as published by the Free Software Foundation.
 *
 * This program is distributed in the hope that it will be useful,
 * but WITHOUT ANY WARRANTY; without even the implied warranty of
 * MERCHANTABILITY or FITNESS FOR A PARTICULAR PURPOSE.  See the
 * GNU General Public License for more details.
 */

&mdss_mdp {
	dsi_vm5296_lead_1080p_video: qcom,mdss_dsi_vm5296_lead_1080p_video {
		qcom,mdss-dsi-panel-name = "vm5296 lead 1080p video mode dsi panel";
		zte,lcd-proc-panel-name = "zteLEAD(vm5296+panda)_1080*1920-5.2Inch";
		qcom,cont-splash-enabled;
 		qcom,mdss-dsi-panel-controller = <&mdss_dsi0>;
		qcom,mdss-dsi-panel-type = "dsi_video_mode";
 		qcom,mdss-dsi-panel-destination = "display_1";
		qcom,mdss-dsi-panel-framerate = <60>;
		//qcom,mdss-dsi-panel-clockrate = <866400000>;
		qcom,mdss-dsi-virtual-channel-id = <0>;
		qcom,mdss-dsi-stream = <0>;
		qcom,mdss-dsi-panel-width = <1080>;
		qcom,mdss-dsi-panel-height = <1920>;
		qcom,mdss-dsi-h-front-porch = <46>;
		qcom,mdss-dsi-h-back-porch = <42>;
		qcom,mdss-dsi-h-pulse-width = <6>;
		qcom,mdss-dsi-h-sync-skew = <0>;
		qcom,mdss-dsi-v-back-porch = <3>;
		qcom,mdss-dsi-v-front-porch = <4>;
		qcom,mdss-dsi-v-pulse-width = <2>;
		qcom,mdss-dsi-h-left-border = <0>;
		qcom,mdss-dsi-h-right-border = <0>;
		qcom,mdss-dsi-v-top-border = <0>;
		qcom,mdss-dsi-v-bottom-border = <0>;
		qcom,mdss-dsi-bpp = <24>;
 		qcom,mdss-dsi-color-order = "rgb_swap_rgb";
		qcom,mdss-dsi-underflow-color = <0xff>;
		qcom,mdss-dsi-border-color = <0>;
		qcom,mdss-dsi-on-command = [
			29 01 00 00 00 00 04 B9 FF 52 96
			29 01 00 00 00 00 02 D9 84
			29 01 00 00 00 00 0C B1 02 02 72 92 01 32 33 51 51 57 4D
			29 01 00 00 00 00 02 D2 88
			29 01 00 00 00 00 11 B2 00 04 80 B4 01 06 5A 11 10 00 00 1F 70 03 C4 38
			29 01 00 00 00 00 31 B4 00 FF A0 12 A0 12 01 A6 01 A6 00 00 07 0D 00 1C 04 05 0B 11 22 04 00 00 AF 00 A0 12 A0 12 01 A6 01 A6 00 00 07 0D 00 1C 04 05 0B 04 00 00 AF 85
			29 01 00 00 00 00 03 B6 8A 8A
			29 01 00 00 00 00 05 BA 63 23 68 75
			29 01 00 00 00 00 02 CC 0A
			29 01 00 00 00 00 07 C0 7D 39 04 0F E0 23
			29 01 00 00 00 00 07 C7 00 08 00 00 00 22
			29 01 00 00 00 00 14 D1 56 4B 07 9A 54 6B 27 98 04 04 08 04 04 08 80 7F 00 00 00
			29 01 00 00 00 00 2D C1 01 00 00 06 0B 10 14 18 1B 1F 2A 32 3F 49 53 5B 63 6B 6C 74 7D 88 94 A1 B1 BD CC CF D4 D8 DE E5 EB F7 FF 24 17 46 C6 8B 4B 8C B3 40
			29 01 00 00 00 00 02 BD 01
			29 01 00 00 00 00 2C C1 00 00 06 0B 10 14 18 1B 1F 2A 32 3F 49 53 5B 63 6B 6C 74 7D 88 94 A1 B1 BD CC CF D4 D8 DE E5 EB F7 FF 24 17 46 C6 8B 4B 8C B3 40
			29 01 00 00 00 00 02 BD 02
			29 01 00 00 00 00 2C C1 00 00 06 0B 10 14 18 1B 1F 2A 32 3F 49 53 5B 63 6B 6C 74 7D 88 94 A1 B1 BD CC CF D4 D8 DE E5 EB F7 FF 24 17 46 C6 8B 4B 8C B3 40
			29 01 00 00 00 00 02 BD 03
			29 01 00 00 00 00 2C C1 00 00 06 0B 10 14 18 1B 1F 2A 32 3F 49 53 5B 63 6B 6C 74 7D 88 94 A1 B1 BD CC CF D4 D8 DE E5 EB F7 FF 24 17 46 C6 8B 4B 8C B3 40
			29 01 00 00 00 00 02 BD 00
			29 01 00 00 00 00 28 D3 00 08 03 03 00 00 04 04 32 10 00 00 00 32 13 C0 00 00 32 10 08 00 00 30 00 01 01 03 00 01 01 03 01 40 00 00 00 00 10
			29 01 00 00 00 00 25 D5 20 20 19 19 18 18 19 19 13 12 11 10 18 18 18 18 18 18 18 18 18 18 18 18 18 18 2F 2F 30 30 31 31 35 35 18 18
			29 01 00 00 00 00 25 D6 20 20 18 18 19 19 19 19 10 11 12 13 98 98 98 98 98 98 98 98 98 98 98 98 98 98 2F 2F 30 30 31 31 35 35 98 98
			29 01 00 00 00 00 15 D8 83 A0 00 2A 80 83 A0 00 2A 80 82 A0 00 2A 80 82 A0 00 2A 80
			29 01 00 00 01 00 02 BD 01
			29 01 00 00 00 00 0B D8 00 00 00 00 00 00 00 00 00 00
			29 01 00 00 01 00 02 BD 02
			29 01 00 00 00 00 0B D8 C3 F0 00 3F C0 C3 F0 00 3F C0
			29 01 00 00 01 00 02 BD 00
			29 01 00 00 05 00 04 C9 03 00 12
			29 01 00 00 78 00 02 11 00
			29 01 00 00 14 00 02 29 00
			29 01 00 00 05 00 03 51 0C CC
			29 01 00 00 05 00 02 55 01
			29 01 00 00 05 00 02 53 2C
		];
		qcom,mdss-dsi-off-command = [
			05 01 00 00 32 00 02 28 00
			05 01 00 00 A0 00 02 10 00
		];
		qcom,mdss-dsi-on-command-state = "dsi_lp_mode";
		qcom,mdss-dsi-off-command-state = "dsi_hs_mode";
		qcom,mdss-dsi-lp11-init;
 		qcom,mdss-dsi-h-sync-pulse = <1>;
		qcom,mdss-dsi-traffic-mode = "burst_mode";
		qcom,mdss-dsi-bllp-eof-power-mode;
		qcom,mdss-dsi-bllp-power-mode;
		qcom,mdss-dsi-lane-0-state;
		qcom,mdss-dsi-lane-1-state;
		qcom,mdss-dsi-lane-2-state;
		qcom,mdss-dsi-lane-3-state;
		qcom,mdss-dsi-panel-timings = [D6 36 22 00 62 66 26 36 38 03 04 00];
		qcom,mdss-dsi-t-clk-post = <0x03>;
		qcom,mdss-dsi-t-clk-pre = <0x2b>;
		qcom,mdss-dsi-bl-min-level = <1>;
		qcom,mdss-dsi-bl-max-level = <3000>;
		qcom,mdss-dsi-dma-trigger = "trigger_sw";
		qcom,mdss-dsi-mdp-trigger = "none";
		qcom,mdss-dsi-bl-pmic-control-type = "bl_ctrl_dcs";
		qcom,mdss-dsi-reset-sequence = <1 20>, <0 20>, <1 60>;
		qcom,mdss-pan-physical-width-dimension = <64>;
		qcom,mdss-pan-physical-height-dimension = <115>;
/*		qcom,mdss-dsi-panel-status-check-mode = "reg_read";
		qcom,mdss-dsi-panel-status-command = [06 01 00 01 05 00 02 09 00];
		qcom,mdss-dsi-panel-status-command-state = "dsi_lp_mode";
		qcom,mdss-dsi-panel-status-read-length = <3>;
		qcom,mdss-dsi-panel-status-value = <0x80 0x73 0x04>;
		qcom,mdss-dsi-tx-eot-append;
		qcom,esd-check-enabled;
*/
		qcom,ulps-enabled;
		qcom,mdss-dsi-post-init-delay = <1>;
		//zte,panel-reset-early-enabled;
	};
};
