## kernel/drivers/input/fingerprint/goodix-3238/Kconfig
```kconfig
config FINGERPRINT_GF3238
	tristate "GOODIX fingerprint driver"
	default n
	
config FINGERPRINT_GF3238_NAV
	tristate "GOODIX fingerprint driver NAV"
	default n
```

## kernel/drivers/input/touchscreen/focaltech_3327/Kconfig
```kconfig
#
# Focaltech Touchscreen driver configuration
#

config TOUCHSCREEN_FTS_3327
        bool "Focaltech Touchscreen"
		depends on I2C
		default n
		help
		  Say Y here if you have Focaltech touch panel.
		  If unsure, say N.

config TOUCHSCREEN_FTS_DIRECTORY_3327
    string "Focaltech ts directory name"
    default "focaltech_touch"
    depends on TOUCHSCREEN_FTS
    
```

## kernel/drivers/input/touchscreen/focaltech_8716/Kconfig
```kconfig
#
# Focaltech Touchscreen driver configuration
#

config TOUCHSCREEN_FTS_8716
        bool "Focaltech Touchscreen"
		depends on I2C
		default n
		help
		  Say Y here if you have Focaltech touch panel.
		  If unsure, say N.

config TOUCHSCREEN_FTS_DIRECTORY_8716
    string "Focaltech ts directory name"
    default "focaltech_8716"
    depends on TOUCHSCREEN_FTS_8716
    
```
